## arch/arm/mach-s3c64xx/Kconfig
```kconfig
if ARCH_S3C64XX 

config TARGET_REAL6410
	default y
	bool "Support REAL6410 board"
	select OF_CONTROL
	select SUPPORT_SPL

config S3C64XX
	default y
	bool "Support S3C64XX platform feature"

source "board/samsung/real6410/Kconfig"

endif
```

## board/samsung/real6410/Kconfig
```kconfig
if TARGET_REAL6410

config SYS_BOARD
	default "real6410"

config SYS_VENDOR
	default "samsung"

config SYS_SOC
	default "s3c64xx"

config SYS_CONFIG_NAME
	default "real6410"

endif
```

## configs/real6410_defconfig
```kconfig
CONFIG_ARM=y
CONFIG_ARCH_S3C64XX=y
CONFIG_SPL_LDSCRIPT="board/$(BOARDDIR)/u-boot-spl.lds"
CONFIG_SYS_TEXT_BASE=0x5FB00000
CONFIG_SPL_GPIO_SUPPORT=y
CONFIG_SPL_LIBCOMMON_SUPPORT=y
CONFIG_SPL_LIBGENERIC_SUPPORT=y
CONFIG_SYS_MALLOC_F_LEN=0x100000
CONFIG_NR_DRAM_BANKS=1
CONFIG_ENV_SIZE=0x4000
CONFIG_ENV_OFFSET=0x80000
CONFIG_SPL_TEXT_BASE=0x0C000000
CONFIG_SPL_SERIAL_SUPPORT=y
CONFIG_SPL=y
CONFIG_IDENT_STRING=" for Real6410"
CONFIG_DEFAULT_DEVICE_TREE="s3c64xx-real6410"
CONFIG_SHOW_BOOT_PROGRESS=y
CONFIG_BOOTDELAY=1
CONFIG_USE_BOOTARGS=y
CONFIG_BOOTARGS="root=/dev/mmcblk0p2 rw rootfstype=ext3 console=ttySAC0,115200 rootwait  user_debug=31"
CONFIG_LOGLEVEL=7
CONFIG_CONSOLE_MUX=y
CONFIG_BOARD_EARLY_INIT_F=y
CONFIG_HUSH_PARSER=y
# CONFIG_AUTO_COMPLETE is not set
CONFIG_SYS_PROMPT="REAL6410 # "
CONFIG_CMD_MMC=y
# CONFIG_CMD_SETEXPR is not set
CONFIG_CMD_PING=y
CONFIG_CMD_CACHE=y
CONFIG_CMD_FAT=y
CONFIG_ENV_IS_IN_MMC=y
CONFIG_NET_RANDOM_ETHADDR=y
CONFIG_CLK=y
CONFIG_MMC_BROKEN_CD=y
CONFIG_DM_MMC=y
CONFIG_MMC_SDHCI=y
CONFIG_MMC_SDHCI_S3C64XX=y
CONFIG_SYS_WHITE_ON_BLACK=y
```
